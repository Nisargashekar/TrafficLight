;
; File Name: cyfitterkeil.inc
; 
; PSoC Creator  4.2
;
; Description:
; 
;
;-------------------------------------------------------------------------------
; Copyright (c) 2007-2018 Cypress Semiconductor.  All rights reserved.
; You may use this file only in accordance with the license, terms, conditions, 
; disclaimers, and limitations in the end user license agreement accompanying 
; the software package with which this file was provided.
;-------------------------------------------------------------------------------

#ifndef INCLUDED_CYFITTERKEIL_INC
#define INCLUDED_CYFITTERKEIL_INC
$INCLUDE (cydevicekeil.inc)
$INCLUDE (cydevicekeil_trm.inc)

; Red_LED
Red_LED__0__INTTYPE EQU CYREG_PICU3_INTTYPE7
Red_LED__0__MASK EQU 0x80
Red_LED__0__PC EQU CYREG_PRT3_PC7
Red_LED__0__PORT EQU 3
Red_LED__0__SHIFT EQU 7
Red_LED__AG EQU CYREG_PRT3_AG
Red_LED__AMUX EQU CYREG_PRT3_AMUX
Red_LED__BIE EQU CYREG_PRT3_BIE
Red_LED__BIT_MASK EQU CYREG_PRT3_BIT_MASK
Red_LED__BYP EQU CYREG_PRT3_BYP
Red_LED__CTL EQU CYREG_PRT3_CTL
Red_LED__DM0 EQU CYREG_PRT3_DM0
Red_LED__DM1 EQU CYREG_PRT3_DM1
Red_LED__DM2 EQU CYREG_PRT3_DM2
Red_LED__DR EQU CYREG_PRT3_DR
Red_LED__INP_DIS EQU CYREG_PRT3_INP_DIS
Red_LED__INTTYPE_BASE EQU CYDEV_PICU_INTTYPE_PICU3_BASE
Red_LED__LCD_COM_SEG EQU CYREG_PRT3_LCD_COM_SEG
Red_LED__LCD_EN EQU CYREG_PRT3_LCD_EN
Red_LED__MASK EQU 0x80
Red_LED__PORT EQU 3
Red_LED__PRT EQU CYREG_PRT3_PRT
Red_LED__PRTDSI__CAPS_SEL EQU CYREG_PRT3_CAPS_SEL
Red_LED__PRTDSI__DBL_SYNC_IN EQU CYREG_PRT3_DBL_SYNC_IN
Red_LED__PRTDSI__OE_SEL0 EQU CYREG_PRT3_OE_SEL0
Red_LED__PRTDSI__OE_SEL1 EQU CYREG_PRT3_OE_SEL1
Red_LED__PRTDSI__OUT_SEL0 EQU CYREG_PRT3_OUT_SEL0
Red_LED__PRTDSI__OUT_SEL1 EQU CYREG_PRT3_OUT_SEL1
Red_LED__PRTDSI__SYNC_OUT EQU CYREG_PRT3_SYNC_OUT
Red_LED__PS EQU CYREG_PRT3_PS
Red_LED__SHIFT EQU 7
Red_LED__SLW EQU CYREG_PRT3_SLW

; Green_LED
Green_LED__0__INTTYPE EQU CYREG_PICU3_INTTYPE6
Green_LED__0__MASK EQU 0x40
Green_LED__0__PC EQU CYREG_PRT3_PC6
Green_LED__0__PORT EQU 3
Green_LED__0__SHIFT EQU 6
Green_LED__AG EQU CYREG_PRT3_AG
Green_LED__AMUX EQU CYREG_PRT3_AMUX
Green_LED__BIE EQU CYREG_PRT3_BIE
Green_LED__BIT_MASK EQU CYREG_PRT3_BIT_MASK
Green_LED__BYP EQU CYREG_PRT3_BYP
Green_LED__CTL EQU CYREG_PRT3_CTL
Green_LED__DM0 EQU CYREG_PRT3_DM0
Green_LED__DM1 EQU CYREG_PRT3_DM1
Green_LED__DM2 EQU CYREG_PRT3_DM2
Green_LED__DR EQU CYREG_PRT3_DR
Green_LED__INP_DIS EQU CYREG_PRT3_INP_DIS
Green_LED__INTTYPE_BASE EQU CYDEV_PICU_INTTYPE_PICU3_BASE
Green_LED__LCD_COM_SEG EQU CYREG_PRT3_LCD_COM_SEG
Green_LED__LCD_EN EQU CYREG_PRT3_LCD_EN
Green_LED__MASK EQU 0x40
Green_LED__PORT EQU 3
Green_LED__PRT EQU CYREG_PRT3_PRT
Green_LED__PRTDSI__CAPS_SEL EQU CYREG_PRT3_CAPS_SEL
Green_LED__PRTDSI__DBL_SYNC_IN EQU CYREG_PRT3_DBL_SYNC_IN
Green_LED__PRTDSI__OE_SEL0 EQU CYREG_PRT3_OE_SEL0
Green_LED__PRTDSI__OE_SEL1 EQU CYREG_PRT3_OE_SEL1
Green_LED__PRTDSI__OUT_SEL0 EQU CYREG_PRT3_OUT_SEL0
Green_LED__PRTDSI__OUT_SEL1 EQU CYREG_PRT3_OUT_SEL1
Green_LED__PRTDSI__SYNC_OUT EQU CYREG_PRT3_SYNC_OUT
Green_LED__PS EQU CYREG_PRT3_PS
Green_LED__SHIFT EQU 6
Green_LED__SLW EQU CYREG_PRT3_SLW

; timer_clock
timer_clock__CFG0 EQU CYREG_CLKDIST_DCFG0_CFG0
timer_clock__CFG1 EQU CYREG_CLKDIST_DCFG0_CFG1
timer_clock__CFG2 EQU CYREG_CLKDIST_DCFG0_CFG2
timer_clock__CFG2_SRC_SEL_MASK EQU 0x07
timer_clock__INDEX EQU 0x00
timer_clock__PM_ACT_CFG EQU CYREG_PM_ACT_CFG2
timer_clock__PM_ACT_MSK EQU 0x01
timer_clock__PM_STBY_CFG EQU CYREG_PM_STBY_CFG2
timer_clock__PM_STBY_MSK EQU 0x01

; LED_UpdateISR
LED_UpdateISR__ES2_PATCH EQU 0
LED_UpdateISR__INTC_CLR_EN_REG EQU CYREG_INTC_CLR_EN0
LED_UpdateISR__INTC_CLR_PD_REG EQU CYREG_INTC_CLR_PD0
LED_UpdateISR__INTC_MASK EQU 0x01
LED_UpdateISR__INTC_NUMBER EQU 0
LED_UpdateISR__INTC_PRIOR_NUM EQU 7
LED_UpdateISR__INTC_PRIOR_REG EQU CYREG_INTC_PRIOR0
LED_UpdateISR__INTC_SET_EN_REG EQU CYREG_INTC_SET_EN0
LED_UpdateISR__INTC_SET_PD_REG EQU CYREG_INTC_SET_PD0
LED_UpdateISR__INTC_VECT EQU (CYREG_INTC_VECT_MBASE+0x00)

; LED_UpdateTimer_TimerUDB
LED_UpdateTimer_TimerUDB_rstSts_stsreg__0__MASK EQU 0x01
LED_UpdateTimer_TimerUDB_rstSts_stsreg__0__POS EQU 0
LED_UpdateTimer_TimerUDB_rstSts_stsreg__16BIT_STATUS_AUX_CTL_REG EQU CYREG_B0_UDB11_12_ACTL
LED_UpdateTimer_TimerUDB_rstSts_stsreg__16BIT_STATUS_REG EQU CYREG_B0_UDB11_12_ST
LED_UpdateTimer_TimerUDB_rstSts_stsreg__2__MASK EQU 0x04
LED_UpdateTimer_TimerUDB_rstSts_stsreg__2__POS EQU 2
LED_UpdateTimer_TimerUDB_rstSts_stsreg__3__MASK EQU 0x08
LED_UpdateTimer_TimerUDB_rstSts_stsreg__3__POS EQU 3
LED_UpdateTimer_TimerUDB_rstSts_stsreg__MASK EQU 0x0D
LED_UpdateTimer_TimerUDB_rstSts_stsreg__MASK_REG EQU CYREG_B0_UDB11_MSK
LED_UpdateTimer_TimerUDB_rstSts_stsreg__MASK_ST_AUX_CTL_REG EQU CYREG_B0_UDB11_MSK_ACTL
LED_UpdateTimer_TimerUDB_rstSts_stsreg__PER_ST_AUX_CTL_REG EQU CYREG_B0_UDB11_MSK_ACTL
LED_UpdateTimer_TimerUDB_rstSts_stsreg__STATUS_AUX_CTL_REG EQU CYREG_B0_UDB11_ACTL
LED_UpdateTimer_TimerUDB_rstSts_stsreg__STATUS_CNT_REG EQU CYREG_B0_UDB11_ST_CTL
LED_UpdateTimer_TimerUDB_rstSts_stsreg__STATUS_CONTROL_REG EQU CYREG_B0_UDB11_ST_CTL
LED_UpdateTimer_TimerUDB_rstSts_stsreg__STATUS_REG EQU CYREG_B0_UDB11_ST
LED_UpdateTimer_TimerUDB_sCTRLReg_SyncCtl_ctrlreg__16BIT_CONTROL_AUX_CTL_REG EQU CYREG_B0_UDB11_12_ACTL
LED_UpdateTimer_TimerUDB_sCTRLReg_SyncCtl_ctrlreg__16BIT_CONTROL_CONTROL_REG EQU CYREG_B0_UDB11_12_CTL
LED_UpdateTimer_TimerUDB_sCTRLReg_SyncCtl_ctrlreg__16BIT_CONTROL_COUNT_REG EQU CYREG_B0_UDB11_12_CTL
LED_UpdateTimer_TimerUDB_sCTRLReg_SyncCtl_ctrlreg__16BIT_COUNT_CONTROL_REG EQU CYREG_B0_UDB11_12_CTL
LED_UpdateTimer_TimerUDB_sCTRLReg_SyncCtl_ctrlreg__16BIT_COUNT_COUNT_REG EQU CYREG_B0_UDB11_12_CTL
LED_UpdateTimer_TimerUDB_sCTRLReg_SyncCtl_ctrlreg__16BIT_MASK_MASK_REG EQU CYREG_B0_UDB11_12_MSK
LED_UpdateTimer_TimerUDB_sCTRLReg_SyncCtl_ctrlreg__16BIT_MASK_PERIOD_REG EQU CYREG_B0_UDB11_12_MSK
LED_UpdateTimer_TimerUDB_sCTRLReg_SyncCtl_ctrlreg__16BIT_PERIOD_MASK_REG EQU CYREG_B0_UDB11_12_MSK
LED_UpdateTimer_TimerUDB_sCTRLReg_SyncCtl_ctrlreg__16BIT_PERIOD_PERIOD_REG EQU CYREG_B0_UDB11_12_MSK
LED_UpdateTimer_TimerUDB_sCTRLReg_SyncCtl_ctrlreg__7__MASK EQU 0x80
LED_UpdateTimer_TimerUDB_sCTRLReg_SyncCtl_ctrlreg__7__POS EQU 7
LED_UpdateTimer_TimerUDB_sCTRLReg_SyncCtl_ctrlreg__CONTROL_AUX_CTL_REG EQU CYREG_B0_UDB11_ACTL
LED_UpdateTimer_TimerUDB_sCTRLReg_SyncCtl_ctrlreg__CONTROL_REG EQU CYREG_B0_UDB11_CTL
LED_UpdateTimer_TimerUDB_sCTRLReg_SyncCtl_ctrlreg__CONTROL_ST_REG EQU CYREG_B0_UDB11_ST_CTL
LED_UpdateTimer_TimerUDB_sCTRLReg_SyncCtl_ctrlreg__COUNT_REG EQU CYREG_B0_UDB11_CTL
LED_UpdateTimer_TimerUDB_sCTRLReg_SyncCtl_ctrlreg__COUNT_ST_REG EQU CYREG_B0_UDB11_ST_CTL
LED_UpdateTimer_TimerUDB_sCTRLReg_SyncCtl_ctrlreg__MASK EQU 0x80
LED_UpdateTimer_TimerUDB_sCTRLReg_SyncCtl_ctrlreg__MASK_CTL_AUX_CTL_REG EQU CYREG_B0_UDB11_MSK_ACTL
LED_UpdateTimer_TimerUDB_sCTRLReg_SyncCtl_ctrlreg__PER_CTL_AUX_CTL_REG EQU CYREG_B0_UDB11_MSK_ACTL
LED_UpdateTimer_TimerUDB_sCTRLReg_SyncCtl_ctrlreg__PERIOD_REG EQU CYREG_B0_UDB11_MSK
LED_UpdateTimer_TimerUDB_sT8_timerdp_u0__16BIT_A0_REG EQU CYREG_B0_UDB11_12_A0
LED_UpdateTimer_TimerUDB_sT8_timerdp_u0__16BIT_A1_REG EQU CYREG_B0_UDB11_12_A1
LED_UpdateTimer_TimerUDB_sT8_timerdp_u0__16BIT_D0_REG EQU CYREG_B0_UDB11_12_D0
LED_UpdateTimer_TimerUDB_sT8_timerdp_u0__16BIT_D1_REG EQU CYREG_B0_UDB11_12_D1
LED_UpdateTimer_TimerUDB_sT8_timerdp_u0__16BIT_DP_AUX_CTL_REG EQU CYREG_B0_UDB11_12_ACTL
LED_UpdateTimer_TimerUDB_sT8_timerdp_u0__16BIT_F0_REG EQU CYREG_B0_UDB11_12_F0
LED_UpdateTimer_TimerUDB_sT8_timerdp_u0__16BIT_F1_REG EQU CYREG_B0_UDB11_12_F1
LED_UpdateTimer_TimerUDB_sT8_timerdp_u0__A0_A1_REG EQU CYREG_B0_UDB11_A0_A1
LED_UpdateTimer_TimerUDB_sT8_timerdp_u0__A0_REG EQU CYREG_B0_UDB11_A0
LED_UpdateTimer_TimerUDB_sT8_timerdp_u0__A1_REG EQU CYREG_B0_UDB11_A1
LED_UpdateTimer_TimerUDB_sT8_timerdp_u0__D0_D1_REG EQU CYREG_B0_UDB11_D0_D1
LED_UpdateTimer_TimerUDB_sT8_timerdp_u0__D0_REG EQU CYREG_B0_UDB11_D0
LED_UpdateTimer_TimerUDB_sT8_timerdp_u0__D1_REG EQU CYREG_B0_UDB11_D1
LED_UpdateTimer_TimerUDB_sT8_timerdp_u0__DP_AUX_CTL_REG EQU CYREG_B0_UDB11_ACTL
LED_UpdateTimer_TimerUDB_sT8_timerdp_u0__F0_F1_REG EQU CYREG_B0_UDB11_F0_F1
LED_UpdateTimer_TimerUDB_sT8_timerdp_u0__F0_REG EQU CYREG_B0_UDB11_F0
LED_UpdateTimer_TimerUDB_sT8_timerdp_u0__F1_REG EQU CYREG_B0_UDB11_F1
LED_UpdateTimer_TimerUDB_sT8_timerdp_u0__MSK_DP_AUX_CTL_REG EQU CYREG_B0_UDB11_MSK_ACTL
LED_UpdateTimer_TimerUDB_sT8_timerdp_u0__PER_DP_AUX_CTL_REG EQU CYREG_B0_UDB11_MSK_ACTL

; Miscellaneous
BCLK__BUS_CLK__HZ EQU 24000000
BCLK__BUS_CLK__KHZ EQU 24000
BCLK__BUS_CLK__MHZ EQU 24
CY_PROJECT_NAME LIT 'Traficlight'
CY_VERSION LIT 'PSoC Creator  4.2'
CYDEV_CHIP_DIE_LEOPARD EQU 1
CYDEV_CHIP_DIE_PSOC4A EQU 18
CYDEV_CHIP_DIE_PSOC5LP EQU 2
CYDEV_CHIP_DIE_PSOC5TM EQU 3
CYDEV_CHIP_DIE_TMA4 EQU 4
CYDEV_CHIP_DIE_UNKNOWN EQU 0
CYDEV_CHIP_FAMILY_FM0P EQU 5
CYDEV_CHIP_FAMILY_FM3 EQU 6
CYDEV_CHIP_FAMILY_FM4 EQU 7
CYDEV_CHIP_FAMILY_PSOC3 EQU 1
CYDEV_CHIP_FAMILY_PSOC4 EQU 2
CYDEV_CHIP_FAMILY_PSOC5 EQU 3
CYDEV_CHIP_FAMILY_PSOC6 EQU 4
CYDEV_CHIP_FAMILY_UNKNOWN EQU 0
CYDEV_CHIP_FAMILY_USED EQU CYDEV_CHIP_FAMILY_PSOC3
CYDEV_CHIP_JTAG_ID EQU 0x1E028069
CYDEV_CHIP_MEMBER_3A EQU 1
CYDEV_CHIP_MEMBER_4A EQU 18
CYDEV_CHIP_MEMBER_4D EQU 13
CYDEV_CHIP_MEMBER_4E EQU 6
CYDEV_CHIP_MEMBER_4F EQU 19
CYDEV_CHIP_MEMBER_4G EQU 4
CYDEV_CHIP_MEMBER_4H EQU 17
CYDEV_CHIP_MEMBER_4I EQU 23
CYDEV_CHIP_MEMBER_4J EQU 14
CYDEV_CHIP_MEMBER_4K EQU 15
CYDEV_CHIP_MEMBER_4L EQU 22
CYDEV_CHIP_MEMBER_4M EQU 21
CYDEV_CHIP_MEMBER_4N EQU 10
CYDEV_CHIP_MEMBER_4O EQU 7
CYDEV_CHIP_MEMBER_4P EQU 20
CYDEV_CHIP_MEMBER_4Q EQU 12
CYDEV_CHIP_MEMBER_4R EQU 8
CYDEV_CHIP_MEMBER_4S EQU 11
CYDEV_CHIP_MEMBER_4T EQU 9
CYDEV_CHIP_MEMBER_4U EQU 5
CYDEV_CHIP_MEMBER_4V EQU 16
CYDEV_CHIP_MEMBER_5A EQU 3
CYDEV_CHIP_MEMBER_5B EQU 2
CYDEV_CHIP_MEMBER_6A EQU 24
CYDEV_CHIP_MEMBER_FM3 EQU 28
CYDEV_CHIP_MEMBER_FM4 EQU 29
CYDEV_CHIP_MEMBER_PDL_FM0P_TYPE1 EQU 25
CYDEV_CHIP_MEMBER_PDL_FM0P_TYPE2 EQU 26
CYDEV_CHIP_MEMBER_PDL_FM0P_TYPE3 EQU 27
CYDEV_CHIP_MEMBER_UNKNOWN EQU 0
CYDEV_CHIP_MEMBER_USED EQU CYDEV_CHIP_MEMBER_3A
CYDEV_CHIP_DIE_EXPECT EQU CYDEV_CHIP_MEMBER_USED
CYDEV_CHIP_DIE_ACTUAL EQU CYDEV_CHIP_DIE_EXPECT
CYDEV_CHIP_REV_LEOPARD_ES1 EQU 0
CYDEV_CHIP_REV_LEOPARD_ES2 EQU 1
CYDEV_CHIP_REV_LEOPARD_ES3 EQU 3
CYDEV_CHIP_REV_LEOPARD_PRODUCTION EQU 3
CYDEV_CHIP_REV_PSOC4A_ES0 EQU 17
CYDEV_CHIP_REV_PSOC4A_PRODUCTION EQU 17
CYDEV_CHIP_REV_PSOC5LP_ES0 EQU 0
CYDEV_CHIP_REV_PSOC5LP_PRODUCTION EQU 0
CYDEV_CHIP_REV_PSOC5TM_ES0 EQU 0
CYDEV_CHIP_REV_PSOC5TM_ES1 EQU 1
CYDEV_CHIP_REV_PSOC5TM_PRODUCTION EQU 1
CYDEV_CHIP_REV_TMA4_ES EQU 17
CYDEV_CHIP_REV_TMA4_ES2 EQU 33
CYDEV_CHIP_REV_TMA4_PRODUCTION EQU 17
CYDEV_CHIP_REVISION_3A_ES1 EQU 0
CYDEV_CHIP_REVISION_3A_ES2 EQU 1
CYDEV_CHIP_REVISION_3A_ES3 EQU 3
CYDEV_CHIP_REVISION_3A_PRODUCTION EQU 3
CYDEV_CHIP_REVISION_4A_ES0 EQU 17
CYDEV_CHIP_REVISION_4A_PRODUCTION EQU 17
CYDEV_CHIP_REVISION_4D_PRODUCTION EQU 0
CYDEV_CHIP_REVISION_4E_CCG2_NO_USBPD EQU 0
CYDEV_CHIP_REVISION_4E_PRODUCTION EQU 0
CYDEV_CHIP_REVISION_4F_PRODUCTION EQU 0
CYDEV_CHIP_REVISION_4F_PRODUCTION_256DMA EQU 0
CYDEV_CHIP_REVISION_4F_PRODUCTION_256K EQU 0
CYDEV_CHIP_REVISION_4G_ES EQU 17
CYDEV_CHIP_REVISION_4G_ES2 EQU 33
CYDEV_CHIP_REVISION_4G_PRODUCTION EQU 17
CYDEV_CHIP_REVISION_4H_PRODUCTION EQU 0
CYDEV_CHIP_REVISION_4I_PRODUCTION EQU 0
CYDEV_CHIP_REVISION_4J_PRODUCTION EQU 0
CYDEV_CHIP_REVISION_4K_PRODUCTION EQU 0
CYDEV_CHIP_REVISION_4L_PRODUCTION EQU 0
CYDEV_CHIP_REVISION_4M_PRODUCTION EQU 0
CYDEV_CHIP_REVISION_4N_PRODUCTION EQU 0
CYDEV_CHIP_REVISION_4O_PRODUCTION EQU 0
CYDEV_CHIP_REVISION_4P_PRODUCTION EQU 0
CYDEV_CHIP_REVISION_4Q_PRODUCTION EQU 0
CYDEV_CHIP_REVISION_4R_PRODUCTION EQU 0
CYDEV_CHIP_REVISION_4S_PRODUCTION EQU 0
CYDEV_CHIP_REVISION_4T_PRODUCTION EQU 0
CYDEV_CHIP_REVISION_4U_PRODUCTION EQU 0
CYDEV_CHIP_REVISION_4V_PRODUCTION EQU 0
CYDEV_CHIP_REVISION_5A_ES0 EQU 0
CYDEV_CHIP_REVISION_5A_ES1 EQU 1
CYDEV_CHIP_REVISION_5A_PRODUCTION EQU 1
CYDEV_CHIP_REVISION_5B_ES0 EQU 0
CYDEV_CHIP_REVISION_5B_PRODUCTION EQU 0
CYDEV_CHIP_REVISION_6A_ES EQU 17
CYDEV_CHIP_REVISION_6A_NO_UDB EQU 33
CYDEV_CHIP_REVISION_6A_PRODUCTION EQU 33
CYDEV_CHIP_REVISION_FM3_PRODUCTION EQU 0
CYDEV_CHIP_REVISION_FM4_PRODUCTION EQU 0
CYDEV_CHIP_REVISION_PDL_FM0P_TYPE1_PRODUCTION EQU 0
CYDEV_CHIP_REVISION_PDL_FM0P_TYPE2_PRODUCTION EQU 0
CYDEV_CHIP_REVISION_PDL_FM0P_TYPE3_PRODUCTION EQU 0
CYDEV_CHIP_REVISION_USED EQU CYDEV_CHIP_REVISION_3A_PRODUCTION
CYDEV_CHIP_REV_EXPECT EQU CYDEV_CHIP_REVISION_USED
CYDEV_CONFIG_FASTBOOT_ENABLED EQU 1
CYDEV_CONFIG_UNUSED_IO_AllowButWarn EQU 0
CYDEV_CONFIG_UNUSED_IO EQU CYDEV_CONFIG_UNUSED_IO_AllowButWarn
CYDEV_CONFIG_UNUSED_IO_AllowWithInfo EQU 1
CYDEV_CONFIG_UNUSED_IO_Disallowed EQU 2
CYDEV_CONFIGURATION_CLEAR_SRAM EQU 1
CYDEV_CONFIGURATION_COMPRESSED EQU 1
CYDEV_CONFIGURATION_DMA EQU 0
CYDEV_CONFIGURATION_ECC EQU 1
CYDEV_CONFIGURATION_IMOENABLED EQU CYDEV_CONFIG_FASTBOOT_ENABLED
CYDEV_CONFIGURATION_MODE_COMPRESSED EQU 0
CYDEV_CONFIGURATION_MODE EQU CYDEV_CONFIGURATION_MODE_COMPRESSED
CYDEV_CONFIGURATION_MODE_DMA EQU 2
CYDEV_CONFIGURATION_MODE_UNCOMPRESSED EQU 1
CYDEV_DEBUG_ENABLE_MASK EQU 0x01
CYDEV_DEBUG_ENABLE_REGISTER EQU CYREG_MLOGIC_DEBUG
CYDEV_DEBUGGING_DPS_Disable EQU 3
CYDEV_DEBUGGING_DPS_JTAG_4 EQU 1
CYDEV_DEBUGGING_DPS_JTAG_5 EQU 0
CYDEV_DEBUGGING_DPS_SWD EQU 2
CYDEV_DEBUGGING_DPS_SWD_SWV EQU 6
CYDEV_DEBUGGING_DPS EQU CYDEV_DEBUGGING_DPS_SWD_SWV
CYDEV_DEBUGGING_ENABLE EQU 1
CYDEV_DEBUGGING_XRES EQU 0
CYDEV_DMA_CHANNELS_AVAILABLE EQU 24
CYDEV_ECC_ENABLE EQU 0
CYDEV_INSTRUCT_CACHE_ENABLED EQU 1
CYDEV_INTR_RISING EQU 0x00000001
CYDEV_IS_EXPORTING_CODE EQU 0
CYDEV_IS_IMPORTING_CODE EQU 0
CYDEV_PROJ_TYPE EQU 0
CYDEV_PROJ_TYPE_BOOTLOADER EQU 1
CYDEV_PROJ_TYPE_LAUNCHER EQU 5
CYDEV_PROJ_TYPE_LOADABLE EQU 2
CYDEV_PROJ_TYPE_LOADABLEANDBOOTLOADER EQU 4
CYDEV_PROJ_TYPE_MULTIAPPBOOTLOADER EQU 3
CYDEV_PROJ_TYPE_STANDARD EQU 0
CYDEV_PROTECTION_ENABLE EQU 0
CYDEV_VARIABLE_VDDA EQU 0
CYDEV_VDDA LIT '5.0'
CYDEV_VDDA_MV EQU 5000
CYDEV_VDDD LIT '5.0'
CYDEV_VDDD_MV EQU 5000
CYDEV_VDDIO0 LIT '5.0'
CYDEV_VDDIO0_MV EQU 5000
CYDEV_VDDIO1 LIT '5.0'
CYDEV_VDDIO1_MV EQU 5000
CYDEV_VDDIO2 LIT '5.0'
CYDEV_VDDIO2_MV EQU 5000
CYDEV_VDDIO3 LIT '5.0'
CYDEV_VDDIO3_MV EQU 5000
CYDEV_VIO0 LIT '5.0'
CYDEV_VIO0_MV EQU 5000
CYDEV_VIO1 LIT '5.0'
CYDEV_VIO1_MV EQU 5000
CYDEV_VIO2 LIT '5.0'
CYDEV_VIO2_MV EQU 5000
CYDEV_VIO3 LIT '5.0'
CYDEV_VIO3_MV EQU 5000
CYIPBLOCK_DP8051_VERSION EQU 0
CYIPBLOCK_P3_ANAIF_VERSION EQU 0
CYIPBLOCK_P3_CAN_VERSION EQU 0
CYIPBLOCK_P3_CAPSENSE_VERSION EQU 0
CYIPBLOCK_P3_COMP_VERSION EQU 0
CYIPBLOCK_P3_DECIMATOR_VERSION EQU 0
CYIPBLOCK_P3_DFB_VERSION EQU 0
CYIPBLOCK_P3_DMA_VERSION EQU 0
CYIPBLOCK_P3_DRQ_VERSION EQU 0
CYIPBLOCK_P3_DSM_VERSION EQU 0
CYIPBLOCK_P3_EMIF_VERSION EQU 0
CYIPBLOCK_P3_I2C_VERSION EQU 0
CYIPBLOCK_P3_LCD_VERSION EQU 0
CYIPBLOCK_P3_LPF_VERSION EQU 0
CYIPBLOCK_P3_OPAMP_VERSION EQU 0
CYIPBLOCK_P3_PM_VERSION EQU 0
CYIPBLOCK_P3_SCCT_VERSION EQU 0
CYIPBLOCK_P3_TIMER_VERSION EQU 0
CYIPBLOCK_P3_USB_VERSION EQU 0
CYIPBLOCK_P3_VIDAC_VERSION EQU 0
CYIPBLOCK_P3_VREF_VERSION EQU 0
CYIPBLOCK_S8_GPIO_VERSION EQU 0
CYIPBLOCK_S8_IRQ_VERSION EQU 0
CYIPBLOCK_S8_SIO_VERSION EQU 0
CYIPBLOCK_S8_UDB_VERSION EQU 0
DMA_CHANNELS_USED__MASK0 EQU 0x00000000
CYDEV_BOOTLOADER_ENABLE EQU 0

#endif /* INCLUDED_CYFITTERKEIL_INC */
